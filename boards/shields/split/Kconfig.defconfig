## boards/shields/split/Kconfig.defconfig
```kconfig
if SHIELD_SPLIT_LEFT

config ZMK_KEYBOARD_NAME
    default "The BOSS Keyboard"

config ZMK_SPLIT_ROLE_CENTRAL
    default y

config ZMK_STUDIO
    default y

config CONFIG_ZMK_BLE_EXPERIMENTAL_CONN
    def_bool y

config CONFIG_ZMK_HID_REPORT_TYPE_NKRO
    def_bool n

endif


if SHIELD_SPLIT_LEFT || SHIELD_SPLIT_RIGHT

config ZMK_SPLIT
    default y

endif
```

## boards/shields/split/Kconfig.shield
```kconfig
config SHIELD_SPLIT_LEFT
	def_bool $(shields_list_contains,split_left)

config SHIELD_SPLIT_RIGHT
	def_bool $(shields_list_contains,split_right)
```
